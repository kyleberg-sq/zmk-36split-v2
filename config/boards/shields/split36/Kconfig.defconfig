## config/boards/shields/split36/Kconfig.defconfig
```kconfig
# Left half configuration
if SHIELD_SPLIT36_LEFT
    config SPLIT36
        default "Split36 Left"

    config SPLIT36_CENTRAL
        default y
endif

# Right half configuration
if SHIELD_SPLIT36_RIGHT
    config SPLIT36
        default "Split36 Right"

    config SPLIT36_CENTRAL
        default n
endif
if SHIELD_SPLIT36
    config ZMK_KEYBOARD_NAME
        default "Split36"
endif
```

## config/boards/shields/split36/Kconfig.shield
```kconfig
# Define left half shield
config SHIELD_SPLIT36_LEFT
    def_bool $(shields_list_contains,SPLIT36_LEFT)

# Define right half shield
config SHIELD_SPLIT36_RIGHT
    def_bool $(shields_list_contains,SPLIT36_RIGHT)
```
